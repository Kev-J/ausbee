## Operating_Systems/Kconfig
```kconfig
# This file is part of AUSBEE.
#
# Copyright (C) 2015 AUSBEE Developers <ausbee@googlegroups.com>
#
# AUSBEE is free software: you can redistribute it and/or modify
# it under the terms of the GNU General Public License as published by
# the Free Software Foundation, either version 3 of the License, or
# (at your option) any later version.
# 
# AUSBEE is distributed in the hope that it will be useful,
# but WITHOUT ANY WARRANTY; without even the implied warranty of
# MERCHANTABILITY or FITNESS FOR A PARTICULAR PURPOSE.  See the
# GNU General Public License for more details.
# 
# You should have received a copy of the GNU General Public License
# along with AUSBEE.  If not, see <http://www.gnu.org/licenses/>.

choice
    prompt "Operating System"

config OS_NONE
    bool "None"

config OS_USE_FREERTOS
    bool "FreeRTOS"

endchoice

menu "Operating System Configuration"
depends on OS_USE_FREERTOS
source "$AUSBEE_DIR/Operating_Systems/FreeRTOS/Kconfig"
endmenu

choice
    prompt "Simulation port used"
    depends on OS_USE_FREERTOS

config OS_LINUX_PORT
    bool "Linux port"

config OS_POSIX_PORT
    bool "Posix port"

endchoice
```

## Packages/Kconfig
```kconfig
# This file is part of AUSBEE.
#
# Copyright (C) 2015 AUSBEE Developers <ausbee@googlegroups.com>
#
# AUSBEE is free software: you can redistribute it and/or modify
# it under the terms of the GNU General Public License as published by
# the Free Software Foundation, either version 3 of the License, or
# (at your option) any later version.
# 
# AUSBEE is distributed in the hope that it will be useful,
# but WITHOUT ANY WARRANTY; without even the implied warranty of
# MERCHANTABILITY or FITNESS FOR A PARTICULAR PURPOSE.  See the
# GNU General Public License for more details.
# 
# You should have received a copy of the GNU General Public License
# along with AUSBEE.  If not, see <http://www.gnu.org/licenses/>.

#get custom packages Kconfig path
config AUSBEE_CUSTOM_PACKAGES_KCONFIG_PATH
  string
  option env="AUSBEE_CUSTOM_PACKAGES_KCONFIG_PATH"

config AUSBEE_CUSTOM_PACKAGES_PATH
  string
  option env="AUSBEE_CUSTOM_PACKAGES_PATH"


config CUSTOM_PACKAGES
  bool "Custom packages"
	default n

comment "/!\\ A restart will be required for any change on custom packages configuration"
  depends on CUSTOM_PACKAGES

config CUSTOM_PACKAGES_REL_PATH
  bool "Use relative path for custom packages"
	default y
  depends on CUSTOM_PACKAGES

config CUSTOM_PACKAGES_PATH
	string "Custom packages path"
  depends on CUSTOM_PACKAGES

# STM32F7XX_HAL_Driver
config STM32L0XX_HAL_DRIVER
	bool "STM32L0xx HAL Driver"
	default n
	depends on 	DEVICE_STM32L011xx || DEVICE_STM32L021xx || \
			DEVICE_STM32L031xx || DEVICE_STM32L041xx || \
			DEVICE_STM32L051xx || DEVICE_STM32L052xx || \
			DEVICE_STM32L053xx || DEVICE_STM32L061xx || \
			DEVICE_STM32L062xx || DEVICE_STM32L063xx || \
			DEVICE_STM32L071xx || DEVICE_STM32L072xx || \
			DEVICE_STM32L073xx || DEVICE_STM32L081xx || \
			DEVICE_STM32L082xx || DEVICE_STM32L083xx

# STM32F10X_StdPeriph_Driver
config STM32F10X_STDPERIPH_DRIVER
	bool "STM32F10x StdPeriph Driver"
	default n
	depends on DEVICE_STM32F10X_LD || DEVICE_STM32F10X_LD_VL || \
		DEVICE_STM32F10X_MD || DEVICE_STM32F10X_MD_VL || \
		DEVICE_STM32F10X_HD || DEVICE_STM32F10X_HD_VL || \
		DEVICE_STM32F10X_XL || DEVICE_STM32F10X_CL
	help
		TODO

source "$AUSBEE_DIR/Packages/stm32f10x_stdperiph_driver/Kconfig"

# STM32F4XX_StdPeriph_Driver
config STM32F4XX_STDPERIPH_DRIVER
	bool "STM32F4xx StdPeriph Driver"
	default n
	depends on  DEVICE_STM32F40_41xxx || DEVICE_STM32F427_437xx || \
                    DEVICE_STM32F429_439xx || DEVICE_STM32F401xx
	help
		TODO

source "$AUSBEE_DIR/Packages/stm32f4xx_stdperiph_driver/Kconfig"

# STM32F7XX_HAL_Driver
config STM32F7XX_HAL_DRIVER
	bool "STM32F7xx HAL Driver"
	default n
	depends on  DEVICE_STM32F756xx || DEVICE_STM32F746xx || \
                    DEVICE_STM32F745xx

# Libausbee
config LIBAUSBEE
	bool "libausbee"
	depends on STM32F4XX_STDPERIPH_DRIVER || STM32F10X_STDPERIPH_DRIVER
	default n
	help
		libausbee by EIRBOT
		TODO

comment "LIBAUSBEE (Select StdPeriph_Driver)"
depends on !(STM32F4XX_STDPERIPH_DRIVER || STM32F10X_STDPERIPH_DRIVER)

#STM32 USB Device Library
config STM32_USB_DEVICE_LIBRARY
	bool "STM32 USB Device Library"
	default n
	help
		STM32 USB libray

#STM32 TouchSensing Library
config STM32_TOUCHSENSING_LIBRARY
	bool "STM32 TouchSensing Library"
	default n
	help
		STM32 Touch sensitive managing library

source "$AUSBEE_DIR/Packages/libausbee/Kconfig"
source "$AUSBEE_CUSTOM_PACKAGES_KCONFIG_PATH"
```

## Packages/libausbee/Kconfig
```kconfig
# This file is part of AUSBEE.
#
# Copyright (C) 2015 AUSBEE Developers <ausbee@googlegroups.com>
#
# AUSBEE is free software: you can redistribute it and/or modify
# it under the terms of the GNU General Public License as published by
# the Free Software Foundation, either version 3 of the License, or
# (at your option) any later version.
# 
# AUSBEE is distributed in the hope that it will be useful,
# but WITHOUT ANY WARRANTY; without even the implied warranty of
# MERCHANTABILITY or FITNESS FOR A PARTICULAR PURPOSE.  See the
# GNU General Public License for more details.
# 
# You should have received a copy of the GNU General Public License
# along with AUSBEE.  If not, see <http://www.gnu.org/licenses/>.

config LIBAUSBEE_CONTROL_SYSTEM
	bool "+ Control system"
	default n
	depends on LIBAUSBEE
	help
		Control engineering.

config LIBAUSBEE_DRIVERS
	bool "+ Drivers"
	default n
	depends on LIBAUSBEE
	help
		Drivers for several devices
```

## Packages/stm32f4xx_stdperiph_driver/Kconfig
```kconfig
# This file is part of AUSBEE.
#
# Copyright (C) 2015 AUSBEE Developers <ausbee@googlegroups.com>
#
# AUSBEE is free software: you can redistribute it and/or modify
# it under the terms of the GNU General Public License as published by
# the Free Software Foundation, either version 3 of the License, or
# (at your option) any later version.
# 
# AUSBEE is distributed in the hope that it will be useful,
# but WITHOUT ANY WARRANTY; without even the implied warranty of
# MERCHANTABILITY or FITNESS FOR A PARTICULAR PURPOSE.  See the
# GNU General Public License for more details.
# 
# You should have received a copy of the GNU General Public License
# along with AUSBEE.  If not, see <http://www.gnu.org/licenses/>.

config STM32F4XX_STDPERIPH_DRIVER_CAN
	bool "+ CAN"
	depends on STM32F4XX_STDPERIPH_DRIVER
	help
		TODO

config STM32F4XX_STDPERIPH_DRIVER_ADC
	bool "+ ADC"
	depends on STM32F4XX_STDPERIPH_DRIVER
	help
		TODO

config STM32F4XX_STDPERIPH_DRIVER_RCC
	bool "+ RCC"
	depends on STM32F4XX_STDPERIPH_DRIVER
	help
		TODO

config STM32F4XX_STDPERIPH_DRIVER_GPIO
	bool "+ GPIO"
	depends on STM32F4XX_STDPERIPH_DRIVER
	help
		TODO

config STM32F4XX_STDPERIPH_DRIVER_TIM
	bool "+ TIM"
	depends on STM32F4XX_STDPERIPH_DRIVER
	help
		TODO

config STM32F4XX_STDPERIPH_DRIVER_USART
	bool "+ USART"
	depends on STM32F4XX_STDPERIPH_DRIVER
	help
		TODO

config STM32F4XX_STDPERIPH_SPI
	bool "+ SPI"
	depends on STM32F4XX_STDPERIPH_DRIVER
	help
		TODO

config STM32F4XX_STDPERIPH_EXTI
	bool "+ EXTI"
	depends on STM32F4XX_STDPERIPH_DRIVER
	help
		External Interrupt functions

config STM32F4XX_STDPERIPH_SYSCFG
	bool "+ SYSCFG"
	depends on STM32F4XX_STDPERIPH_DRIVER
	help
		System Configuration Controller

config STM32F4XX_STDPERIPH_MISC
	bool "+ MISC"
	depends on STM32F4XX_STDPERIPH_DRIVER
	help
		TODO

#TODO add others
```

## Platforms/Kconfig
```kconfig
# This file is part of AUSBEE.
#
# Copyright (C) 2015 AUSBEE Developers <ausbee@googlegroups.com>
#
# AUSBEE is free software: you can redistribute it and/or modify
# it under the terms of the GNU General Public License as published by
# the Free Software Foundation, either version 3 of the License, or
# (at your option) any later version.
# 
# AUSBEE is distributed in the hope that it will be useful,
# but WITHOUT ANY WARRANTY; without even the implied warranty of
# MERCHANTABILITY or FITNESS FOR A PARTICULAR PURPOSE.  See the
# GNU General Public License for more details.
# 
# You should have received a copy of the GNU General Public License
# along with AUSBEE.  If not, see <http://www.gnu.org/licenses/>.

#get custom platforms Kconfig path
config AUSBEE_CUSTOM_PLATFORMS_KCONFIG_PATH
    string
    option env="AUSBEE_CUSTOM_PLATFORMS_KCONFIG_PATH"

config AUSBEE_CUSTOM_PLATFORMS_OPTION_KCONFIG_PATH
    string
    option env="AUSBEE_CUSTOM_PLATFORMS_OPTION_KCONFIG_PATH"

config AUSBEE_CUSTOM_PLATFORMS_PATH
    string
    option env="AUSBEE_CUSTOM_PLATFORMS_PATH"

config CUSTOM_PLATFORMS
  bool "Custom platforms"
	default n

comment "/!\\ A restart will be required for any change on custom platforms configuration"
  depends on CUSTOM_PLATFORMS

config CUSTOM_PLATFORMS_REL_PATH
  bool "Use relative path for custom platforms"
	default y
  depends on CUSTOM_PLATFORMS

config CUSTOM_PLATFORMS_PATH
	string "Custom platforms path"
  depends on CUSTOM_PLATFORMS

choice
	prompt "Platform select"

	config PLATFORM_NONE
		bool "NONE"
	
	config PLATFORM_AUSBEE_MAIN_BOARD_V0_1
		bool "AUSBEE Main Board V0.1"
                depends on STM32F4XX_STDPERIPH_DRIVER

        comment "AUSBEE Main Board V0.1 require stm32f4xx_StdPeriph_Driver"
                depends on !STM32F4XX_STDPERIPH_DRIVER
	
	config PLATFORM_STM32F4DISCOVERY
		bool "STM32F4DISCOVERY"
                depends on STM32F4XX_STDPERIPH_DRIVER

        comment "STM32F4DISCOVERY require stm32f4xx_StdPeriph_Driver"
                depends on !STM32F4XX_STDPERIPH_DRIVER

	config PLATFORM_AUSBEE_SERVO_MODULE_V0_1
		bool "AUSBEE Servo Module V0.1"
                depends on STM32F10X_STDPERIPH_DRIVER

        comment "AUSBEE Servo Module V0.1 require stm32f10x_StdPeriph_Driver"
                depends on !STM32F10X_STDPERIPH_DRIVER
  source "$AUSBEE_CUSTOM_PLATFORMS_KCONFIG_PATH"
endchoice

source "$AUSBEE_CUSTOM_PLATFORMS_OPTION_KCONFIG_PATH"
```

## Platforms/stm32f7discovery/Kconfig
```kconfig
config PLATFORM_STM32F7DISCOVERY_USE_AUDIO
  bool "Use audio"
  default n

config PLATFORM_STM32F7DISCOVERY_USE_CAMERA
  bool "Use camera"
  default n

config PLATFORM_STM32F7DISCOVERY_USE_EEPROM
  bool "Use AUDIO"
  default n

config PLATFORM_STM32F7DISCOVERY_USE_LCD
  bool "Use LCD"
  default n

config PLATFORM_STM32F7DISCOVERY_USE_QSPI
  bool "Use QSPI"
  default n

config PLATFORM_STM32F7DISCOVERY_USE_SD
  bool "Use SD"
  default n

config PLATFORM_STM32F7DISCOVERY_USE_SDRAM
  bool "Use SDRAM"
  default n

config PLATFORM_STM32F7DISCOVERY_USE_TS
  bool "Use touchscreen"
  default n

config PLATFORM_STM32F7DISCOVERY_USE_SD_DRIVER
  bool "Use SD diskio driver"
  default n
config PLATFORM_STM32F7DISCOVERY_USE_SDRAM_DRIVER
  bool "Use SDRAM diskio driver"
  default n
config PLATFORM_STM32F7DISCOVERY_USE_SRAM_DRIVER
  bool "Use SRAM diskio driver"
  default n
config PLATFORM_STM32F7DISCOVERY_USE_USBH_DRIVER
  bool "Use USBH diskio driver"
  default n
```

## Software/Kconfig
```kconfig
#

mainmenu "AUSBEE Configuration"

########################################
# Build options menu
menu "Build options"

config PROJECT_NAME
	string "Project name"
	default "project"
	help
		TODO

## Device options menu
menu "Device options"

# Select CORE
choice
	prompt "Select ARM core"
config ARM_CORE_CORTEX_M4
	bool "ARM Cortex-M4 core"

config ARM_CORE_CORTEX_M3
	bool "ARM Cortex-M3 core"
endchoice

config USE_FPU
	bool "Use FPU"
	default y
	depends on ARM_CORE_CORTEX_M4
	help
		Use hardware for floating point processings.

# Select Device Cortex-M4
choice
	prompt "Device name Cortex-M4"
	depends on ARM_CORE_CORTEX_M4

config DEVICE_STM32F40_41xxx 
	bool "STM32F40_41xxx"

config DEVICE_STM32F427_437xx
	bool "STM32F427_437xx"

config DEVICE_STM32F429_439xx
	bool "STM32F429_439xx"

config DEVICE_STM32F401xx
	bool "STM32F401xx"
endchoice

# Select Device Cortex-M3
choice
	prompt "Device name Cortex-M3"
	depends on ARM_CORE_CORTEX_M3
config DEVICE_STM32F10X_LD
	bool "STM32F10X_LD"

config DEVICE_STM32F10X_LD_VL
	bool "STM32F10X_LD_VL"

config DEVICE_STM32F10X_MD
	bool "STM32F10X_MD"

config DEVICE_STM32F10X_MD_VL
	bool "STM32F10X_MD_VL"

config DEVICE_STM32F10X_HD
	bool "STM32F10X_HD"

config DEVICE_STM32F10X_HD_VL
	bool "STM32F10X_HD_VL"

config DEVICE_STM32F10X_XL
	bool "STM32F10X_XL"

config DEVICE_STM32F10X_CL
	bool "STM32F10X_CL"
endchoice

config CRYSTAL_FREQUENCY
	string "Crystal frenquency"
	default "8000000"
	help
		HSE Crystal frequency in Hz.

# Ram length
config RAM_LENGTH
	string "RAM length"
	default "10K"
	help
		Amount of RAM memory available on your device.
		You can use capital letters like:
		K for kilobytes
		M for megabytes
		G for gigabytes

# Flash length
config FLASH_LENGTH
	string "FLASH length"
	default "32K"
	help
		Amount of FLASH memory available on your device.
		You can use capital letters like:
		K for kilobytes
		M for megabytes
		G for gigabytes

endmenu

## Debug menu
menu "Debug options"

# Enable debug mode
config DEBUG
	bool "Compile in debug mode"
	default y
	help
		Compile with -DDEBUG. This enable you to disable/enable traces
		when you want by surrounding your code with
		#ifdef DEBUG <CODE> #endif.
		Note that printf and scanf is available only with that mode.

# Usart debug port on target
config USART_DEBUG
	string "USART Debug port"
	default "USART1"
	depends on DEBUG
	help
		Define the port used for print debugging informations. This name should
		be compliant with USARTx format as in stm32fxxx.h file.

endmenu

## Programming interface menu
menu "Programming interface"

# Baudrate for flashing device
config BAUDRATE_SERIAL_INTEFACE
	string "Baudrate of serial programming interface"
	default "115200"
	help
		TODO
# Serial interface for flashing device
config PROGRAM_SERIAL_INTERFACE
	string "Serial programming interface"
	default "/dev/ttyUSB0"
	help
		TODO

endmenu

## Miscelaneous menu
menu "Misc"

# Downloads directory
config DOWNLOADS_DIR
    string "Downloads directory"
    default "$(CURDIR)/downloads"
    help
        If you have already an AUSBEE downloads directory. Use this one to 
	not downloading the archives again.

endmenu
endmenu

########################################
## Toolchain menu
menu "Toolchain"
source "Toolchain/Kconfig"
endmenu

########################################
## Libraries menu
menu "Libraries"
source "Libraries/Kconfig"
endmenu

########################################
## FreeRTOS menu
menu "Operating System"
source "Operating_Systems/Kconfig"
endmenu

########################################
## Platforms menu
menu "Platforms"
source "Platforms/Kconfig"
endmenu
```

## Software/Libraries/Kconfig
```kconfig
config STM32F10X_STDPERIPH_DRIVER
	bool "STM32F10x StdPeriph Driver"
	default n
	depends on DEVICE_STM32F10X_LD || DEVICE_STM32F10X_LD_VL || \
		DEVICE_STM32F10X_MD || DEVICE_STM32F10X_MD_VL || \
		DEVICE_STM32F10X_HD || DEVICE_STM32F10X_HD_VL || \
		DEVICE_STM32F10X_XL || DEVICE_STM32F10X_CL
	help
		TODO

source Libraries/STM32F10x_StdPeriph_Driver/Kconfig

config STM32F4XX_STDPERIPH_DRIVER
	bool "STM32F10x StdPeriph Driver"
	default n
	depends on  DEVICE_STM32F40_41xxx || DEVICE_STM32F427_437xx || \
                    DEVICE_STM32F429_439xx || DEVICE_STM32F401xx
	help
		TODO

source Libraries/STM32F4xx_StdPeriph_Driver/Kconfig

config LIBAUSBEE
	bool "libausbee"
	depends on STM32F4XX_STDPERIPH_DRIVER || STM32F10X_STDPERIPH_DRIVER
	default n
	help
		libausbee by EIRBOT
		TODO
comment "LIBAUSBEE (Select StdPeriph_Driver)"
depends on !(STM32F4XX_STDPERIPH_DRIVER || STM32F10X_STDPERIPH_DRIVER)

source Libraries/libausbee/Kconfig
```
