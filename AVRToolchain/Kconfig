## AVRToolchain/Kconfig
```kconfig
# This file is part of AUSBEE.
#
# Copyright (C) 2015 AUSBEE Developers <ausbee@googlegroups.com>
#
# AUSBEE is free software: you can redistribute it and/or modify
# it under the terms of the GNU General Public License as published by
# the Free Software Foundation, either version 3 of the License, or
# (at your option) any later version.
# 
# AUSBEE is distributed in the hope that it will be useful,
# but WITHOUT ANY WARRANTY; without even the implied warranty of
# MERCHANTABILITY or FITNESS FOR A PARTICULAR PURPOSE.  See the
# GNU General Public License for more details.
# 
# You should have received a copy of the GNU General Public License
# along with AUSBEE.  If not, see <http://www.gnu.org/licenses/>.

config TOOLCHAIN_TARGET_NAME
	string "Target name"
	default "avr"
	help
		TODO

config DOWNLOAD_TOOLCHAIN
    bool "Download GCC ARM embedded toolchain"
    default n
    help
        TODO

config TOOLCHAIN_MIRROR
    string "Toolchain mirror URL"
    default "https://launchpad.net/gcc-arm-embedded/4.7/4.7-2013-q3-update/+download/gcc-arm-none-eabi-4_7-2013q3-20130916-linux.tar.bz2"
    depends on DOWNLOAD_TOOLCHAIN
    help
        TODO

config TOOLCHAIN_CUSTOM_BIN_PATH
	bool "Custom toolchain /bin path"
  depends on !DOWNLOAD_TOOLCHAIN
  default n
	help
		TODO

config TOOLCHAIN_BIN_PATH
	string "Toolchain /bin path"
  depends on TOOLCHAIN_CUSTOM_BIN_PATH
  default "/usr/bin"
	help
		TODO

comment "GCC/G++ options"

# -ffunction-sections and -fdata-sections will tell to gcc to put functions and data in special .text sections.
# This enable the linker to optimize unused functions and data thanks to -Wl,-gc-sections flag.
#
# Add -mthumb-interwork for enabling ARM and Thumb interwork
config TARGET_TOOLCHAIN_COMMON_FLAGS
    string "Common flags (CFLAGS and LDFLAGS)"
    default "-Wall -Wextra -fpack-struct -fshort-enums -Wstrict-prototypes"

config TARGET_TOOLCHAIN_CFLAGS
    string "Toolchain CFLAGS"
    default ""
    help
	TODO

# -fno-rtti disable RunTime Type Informations
# -fno-exceptions disable exceptions
# These two C++ particularities include two much functions overhead
# In a result, you won't be able to use exceptions handling and dynamic casts
config TARGET_TOOLCHAIN_CXXFLAGS
    string "Toolchain CXXFLAGS"
    default "-fno-rtti -fno-exceptions"
    help
	TODO

# -Wl,--gc-sections will remove unused functions and datas thanks to -ffunction-sections and -fdata-sections
# -nostartfiles do not use standard system startup files when linking
config TARGET_TOOLCHAIN_LDFLAGS
    string "Toolchain LDFLAGS"
    default ""
    help
        TODO

config OPTIMISATION
    string "Optimisation"
    default "s"
    help
        TODO
```

## Kconfig
```kconfig
# This file is part of AUSBEE.
#
# Copyright (C) 2015 AUSBEE Developers <ausbee@googlegroups.com>
#
# AUSBEE is free software: you can redistribute it and/or modify
# it under the terms of the GNU General Public License as published by
# the Free Software Foundation, either version 3 of the License, or
# (at your option) any later version.
# 
# AUSBEE is distributed in the hope that it will be useful,
# but WITHOUT ANY WARRANTY; without even the implied warranty of
# MERCHANTABILITY or FITNESS FOR A PARTICULAR PURPOSE.  See the
# GNU General Public License for more details.
# 
# You should have received a copy of the GNU General Public License
# along with AUSBEE.  If not, see <http://www.gnu.org/licenses/>.

mainmenu "AUSBEE Configuration"

config AUSBEE_DIR
    string
    option env="AUSBEE_DIR"


########################################
# Build options menu
menu "Build options"

## Device options menu
menu "Device options"

# Select CORE
choice
	prompt "Select uc core"
config ARM_CORE_CORTEX_M4
	bool "ARM Cortex-M4 core"

config ARM_CORE_CORTEX_M3
	bool "ARM Cortex-M3 core"

config XMEGA_CORE
	bool "AVR xmega core"
endchoice

config USE_FPU
	bool "Use FPU"
	default y
	depends on ARM_CORE_CORTEX_M4
	help
		Use hardware for floating point processings.

# Select Device Cortex-M4
choice
	prompt "Device name Cortex-M4"
	depends on ARM_CORE_CORTEX_M4

config DEVICE_STM32F40_41xxx 
	bool "STM32F40_41xxx"

config DEVICE_STM32F427_437xx
	bool "STM32F427_437xx"

config DEVICE_STM32F429_439xx
	bool "STM32F429_439xx"

config DEVICE_STM32F401xx
	bool "STM32F401xx"
endchoice

# Select Device Cortex-M3
choice
	prompt "Device name Cortex-M3"
	depends on ARM_CORE_CORTEX_M3
config DEVICE_STM32F10X_LD
	bool "STM32F10X_LD"

config DEVICE_STM32F10X_LD_VL
	bool "STM32F10X_LD_VL"

config DEVICE_STM32F10X_MD
	bool "STM32F10X_MD"

config DEVICE_STM32F10X_MD_VL
	bool "STM32F10X_MD_VL"

config DEVICE_STM32F10X_HD
	bool "STM32F10X_HD"

config DEVICE_STM32F10X_HD_VL
	bool "STM32F10X_HD_VL"

config DEVICE_STM32F10X_XL
	bool "STM32F10X_XL"

config DEVICE_STM32F10X_CL
	bool "STM32F10X_CL"
endchoice

# Select Device Xmega
choice
	prompt "Device name"
	depends on XMEGA_CORE

config DEVICE_XMEGA16A4 
	bool "XMEGA16A4"
endchoice


config CRYSTAL_FREQUENCY
	string "Crystal frenquency"
	default "8000000"
	help
		HSE Crystal frequency in Hz.

# Ram length
config RAM_LENGTH
  depends on ARM_CORE_CORTEX_M4 || ARM_CORE_CORTEX_M3
	string "RAM length"
	default "10K"
	help
		Amount of RAM memory available on your device.
		You can use capital letters like:
		K for kilobytes
		M for megabytes
		G for gigabytes

# Flash length
config FLASH_LENGTH
  depends on ARM_CORE_CORTEX_M4 || ARM_CORE_CORTEX_M3
	string "FLASH length"
	default "32K"
	help
		Amount of FLASH memory available on your device.
		You can use capital letters like:
		K for kilobytes
		M for megabytes
		G for gigabytes

# Flash start
config FLASH_START
  depends on ARM_CORE_CORTEX_M4 || ARM_CORE_CORTEX_M3
	string "FLASH start address"
	default "0x08000000"
	help
		Flash start address in hex


endmenu

## Debug menu
menu "Debug options"

# Enable debug mode
config DEBUG
	bool "Compile in debug mode"
	default y
	help
		Compile with -DDEBUG. This enable you to disable/enable traces
		when you want by surrounding your code with
		#ifdef DEBUG <CODE> #endif.
		Note that printf and scanf is available only with that mode.

# Usart debug port on target
config USART_DEBUG
	string "USART Debug port"
	default "USART1"
	depends on DEBUG
	help
		Define the port used for print debugging informations. This name should
		be compliant with USARTx format as in stm32fxxx.h file.

endmenu

## Programming interface menu
menu "Programming interface"

choice
	prompt "Select programmer"

config PROGRAMMING_STLINK
  depends on ARM_CORE_CORTEX_M4 || ARM_CORE_CORTEX_M3
	bool "STLink v2"

config PROGRAMMING_USART
  depends on ARM_CORE_CORTEX_M4 || ARM_CORE_CORTEX_M3
	bool "STM32 USART"

config AVRDUDE_WITH_ISP2
  depends on XMEGA_CORE
	bool "Avrdude with isp2"
endchoice

# Baudrate for flashing device
config BAUDRATE_SERIAL_INTEFACE
	string "Baudrate of serial programming interface"
	default "115200"
	depends on PROGRAMMING_USART
	help
		TODO
# Serial interface for flashing device
config PROGRAM_SERIAL_INTERFACE
	string "Serial programming interface"
	default "/dev/ttyUSB0"
	depends on PROGRAMMING_USART
	help
		TODO

endmenu

## Miscelaneous menu
menu "Misc"

# Downloads directory
config DOWNLOADS_DIR
    string "Downloads directory"
    default "$(CURDIR)/downloads"
    help
        If you have already an AUSBEE downloads directory. Use this one to 
	not downloading the archives again.

endmenu
endmenu


########################################
## Toolchain menu
menu "Toolchain"
depends on ARM_CORE_CORTEX_M4 || ARM_CORE_CORTEX_M3
source "$AUSBEE_DIR/Toolchain/Kconfig"
endmenu

########################################
## Packages menu
menu "Packages"
source "$AUSBEE_DIR/Packages/Kconfig"
endmenu

########################################
## FreeRTOS menu
menu "Operating System"
source "$AUSBEE_DIR/Operating_Systems/Kconfig"
endmenu

########################################
## Platforms menu
menu "Platforms"
source "$AUSBEE_DIR/Platforms/Kconfig"
endmenu
```
