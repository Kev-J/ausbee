## Software/Libraries/STM32F10x_StdPeriph_Driver/Kconfig
```kconfig
config STM32F10X_STDPERIPH_DRIVER_CAN
	bool "+ CAN"
	depends on STM32F10X_STDPERIPH_DRIVER
	help
		TODO

config STM32F10X_STDPERIPH_DRIVER_RCC
	bool "+ RCC"
	depends on STM32F10X_STDPERIPH_DRIVER
	help
		TODO

config STM32F10X_STDPERIPH_DRIVER_GPIO
	bool "+ GPIO"
	depends on STM32F10X_STDPERIPH_DRIVER
	help
		TODO

config STM32F10X_STDPERIPH_DRIVER_TIM
	bool "+ TIM"
	depends on STM32F10X_STDPERIPH_DRIVER
	help
		TODO
#TODO add others
```

## Software/Libraries/STM32F4xx_StdPeriph_Driver/Kconfig
```kconfig
config STM32F4XX_STDPERIPH_DRIVER_CAN
	bool "+ CAN"
	depends on STM32F4XX_STDPERIPH_DRIVER
	help
		TODO

config STM32F4XX_STDPERIPH_DRIVER_RCC
	bool "+ RCC"
	depends on STM32F4XX_STDPERIPH_DRIVER
	help
		TODO

config STM32F4XX_STDPERIPH_DRIVER_GPIO
	bool "+ GPIO"
	depends on STM32F4XX_STDPERIPH_DRIVER
	help
		TODO

config STM32F4XX_STDPERIPH_DRIVER_TIM
	bool "+ TIM"
	depends on STM32F4XX_STDPERIPH_DRIVER
	help
		TODO

config STM32F4XX_STDPERIPH_DRIVER_USART
	bool "+ USART"
	depends on STM32F4XX_STDPERIPH_DRIVER
	help
		TODO

config STM32F4XX_STDPERIPH_MISC
	bool "+ MISC"
	depends on STM32F4XX_STDPERIPH_DRIVER
	help
		TODO


#TODO add others
```

## Software/Libraries/libausbee/Kconfig
```kconfig
config LIBAUSBEE_CONTROL_SYSTEM_MANAGER
	bool "+ Control system manager"
	default n
	depends on LIBAUSBEE
	help
		Manager for control engineering.

config LIBAUSBEE_CONTROLLER
	bool "+ Controller"
	default n
	depends on LIBAUSBEE
	help
		Controller implementation for control engineering.

config LIBAUSBEE_LIDAR
	bool "+ LIDAR"
	default n
	depends on LIBAUSBEE
	help
		TODO

config LIBAUSBEE_L298_DRIVER
	bool "+ L298 Driver"
	default n
	depends on LIBAUSBEE
	help
		TODO

config LIBAUSBEE_ENCODER
	bool "+ ENCODER"
	default n
	depends on LIBAUSBEE
	help
		Encoder init and reading module.

config LIBAUSBEE_SERVO
	bool "+ SERVO"
	default n
	depends on LIBAUSBEE
	help
		TODO

config LIBAUSBEE_AX12
	bool "+ AX12"
	default n
	depends on LIBAUSBEE
	help
		TODO
```

## Software/Operating_Systems/Kconfig
```kconfig
choice
    prompt "Operating System"

config OS_NONE
    bool "None"

config OS_USE_FREERTOS
    bool "FreeRTOS"

endchoice

menu "Operating System Configuration"
depends on OS_USE_FREERTOS
source Operating_Systems/FreeRTOS/Kconfig
endmenu
```

## Software/Platforms/Kconfig
```kconfig
choice
	prompt "Platform select"

	config PLATFORM_NONE
		bool "NONE"
	
	config PLATFORM_AUSBEE_MAIN_BOARD_V0.1
		bool "AUSBEE Main Board V0.1"
                depends on STM32F4XX_STDPERIPH_DRIVER

        comment "AUSBEE Main Board V0.1 require stm32f4xx_StdPeriph_Driver"
                depends on !STM32F4XX_STDPERIPH_DRIVER
	
	config PLATFORM_STM32F4DISCOVERY
		bool "STM32F4DISCOVERY"
                depends on STM32F4XX_STDPERIPH_DRIVER

        comment "STM32F4DISCOVERY require stm32f4xx_StdPeriph_Driver"
                depends on !STM32F4XX_STDPERIPH_DRIVER

	config PLATFORM_AUSBEE_SERVO_MODULE_V0.1
		bool "AUSBEE Servo Module V0.1"
                depends on STM32F10X_STDPERIPH_DRIVER

        comment "AUSBEE Servo Module V0.1 require stm32f10x_StdPeriph_Driver"
                depends on !STM32F10X_STDPERIPH_DRIVER
endchoice
```

## Software/Toolchain/Kconfig
```kconfig
config TOOLCHAIN_TARGET_NAME
	string "Target name"
	default "arm-none-eabi"
	help
		TODO

config DOWNLOAD_TOOLCHAIN
    bool "Download GCC ARM embedded toolchain"
    default y
    help
        TODO

config TOOLCHAIN_MIRROR
    string "Toolchain mirror URL"
    default "https://launchpad.net/gcc-arm-embedded/4.7/4.7-2013-q3-update/+download/gcc-arm-none-eabi-4_7-2013q3-20130916-linux.tar.bz2"
    help
        TODO

config TOOLCHAIN_BIN_PATH
	string "Toolchain /bin path"
	help
		TODO
        depends on !DOWNLOAD_TOOLCHAIN

comment "GCC/G++ options"

# -ffunction-sections and -fdata-sections will tell to gcc to put functions and data in special .text sections.
# This enable the linker to optimize unused functions and data thanks to -Wl,-gc-sections flag.
#
# Add -mthumb-interwork for enabling ARM and Thumb interwork
config TOOLCHAIN_COMMON_FLAGS
    string "Common flags (CFLAGS and LDFLAGS)"
    default "-Wall -Wextra -ffunction-sections -fdata-sections"
    help
        -mthumb -mcpu=cortex-mX and -DDEVICE_NAME will be automatically added according to the selected CPU.
        -DUSE_STDPERIPH_DRIVER will be automatically added according to your choice of including it or not.

config TOOLCHAIN_CFLAGS
    string "Toolchain CFLAGS"
    default ""
    help
	TODO

# -fno-rtti disable RunTime Type Informations
# -fno-exceptions disable exceptions
# These two C++ particularities include two much functions overhead
# In a result, you won't be able to use exceptions handling and dynamic casts
config TOOLCHAIN_CXXFLAGS
    string "Toolchain CXXFLAGS"
    default "-fno-rtti -fno-exceptions"
    help
	TODO

# -Wl,--gc-sections will remove unused functions and datas thanks to -ffunction-sections and -fdata-sections
# -nostartfiles do not use standard system startup files when linking
config TOOLCHAIN_LDFLAGS
    string "Toolchain LDFLAGS"
    default "-Wl,--gc-sections -nostartfiles"
    help
        TODO

config OPTIMISATION
    string "Optimisation"
    default "s"
    help
        TODO
```

## Software/packages/libausbee/Kconfig
```kconfig
#
menu "libausbee"

config LIBAUSBEE_SRC_DIR
	string "libausbee source directory"
	default "$(CURDIR)/libausbee"
	help
		TODO

config LIBAUSBEE_BUILD_LIDAR
    bool "Build libausbee-lidar"
    default n
    help
        TODO

endmenu
```

## Toolchain/Kconfig
```kconfig
# This file is part of AUSBEE.
#
# Copyright (C) 2015 AUSBEE Developers <ausbee@googlegroups.com>
#
# AUSBEE is free software: you can redistribute it and/or modify
# it under the terms of the GNU General Public License as published by
# the Free Software Foundation, either version 3 of the License, or
# (at your option) any later version.
# 
# AUSBEE is distributed in the hope that it will be useful,
# but WITHOUT ANY WARRANTY; without even the implied warranty of
# MERCHANTABILITY or FITNESS FOR A PARTICULAR PURPOSE.  See the
# GNU General Public License for more details.
# 
# You should have received a copy of the GNU General Public License
# along with AUSBEE.  If not, see <http://www.gnu.org/licenses/>.

config TOOLCHAIN_TARGET_NAME
	string "Target name"
  depends on ARM_CORE_CORTEX_M4 || ARM_CORE_CORTEX_M3
	default "arm-none-eabi"
	help
		TODO

config DOWNLOAD_TOOLCHAIN
  bool "Download GCC ARM embedded toolchain"
  depends on ARM_CORE_CORTEX_M4 || ARM_CORE_CORTEX_M3
  default y
  help
    TODO

config TOOLCHAIN_MIRROR
  string "Toolchain mirror URL"
  depends on ARM_CORE_CORTEX_M4 || ARM_CORE_CORTEX_M3
  default "https://launchpad.net/gcc-arm-embedded/4.7/4.7-2013-q3-update/+download/gcc-arm-none-eabi-4_7-2013q3-20130916-linux.tar.bz2"
  depends on DOWNLOAD_TOOLCHAIN
  help
    TODO

config TOOLCHAIN_CUSTOM_BIN_PATH
	bool "Custom toolchain /bin path"
  depends on (!DOWNLOAD_TOOLCHAIN) && (ARM_CORE_CORTEX_M4 || ARM_CORE_CORTEX_M3)
  default n
	help
		TODO

config TOOLCHAIN_BIN_PATH
	string "Toolchain /bin path"
  depends on TOOLCHAIN_CUSTOM_BIN_PATH
  default "/usr/bin"
	help
		TODO

comment "GCC/G++ options"

# -ffunction-sections and -fdata-sections will tell to gcc to put functions and data in special .text sections.
# This enable the linker to optimize unused functions and data thanks to -Wl,-gc-sections flag.
#
# Add -mthumb-interwork for enabling ARM and Thumb interwork
config TOOLCHAIN_COMMON_FLAGS
    string "Common flags (CFLAGS and LDFLAGS)"
    default "-Wall -Wextra -ffunction-sections -fdata-sections"
    help
        -mthumb -mcpu=cortex-mX and -DDEVICE_NAME will be automatically added according to the selected CPU.
        -DUSE_STDPERIPH_DRIVER will be automatically added according to your choice of including it or not.

config TOOLCHAIN_CFLAGS
    string "Toolchain CFLAGS"
    default ""
    help
	TODO

# -fno-rtti disable RunTime Type Informations
# -fno-exceptions disable exceptions
# These two C++ particularities include two much functions overhead
# In a result, you won't be able to use exceptions handling and dynamic casts
config TOOLCHAIN_CXXFLAGS
    string "Toolchain CXXFLAGS"
    default "-fno-rtti -fno-exceptions"
    help
	TODO

# -Wl,--gc-sections will remove unused functions and datas thanks to -ffunction-sections and -fdata-sections
# -nostartfiles do not use standard system startup files when linking
config TOOLCHAIN_LDFLAGS
    string "Toolchain LDFLAGS"
    default "-Wl,--gc-sections -nostartfiles"
    help
        TODO

config OPTIMISATION
    string "Optimisation"
    default "s"
    help
        TODO
```
